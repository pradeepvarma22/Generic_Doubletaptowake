## drivers/input/touchscreen/Kconfig
```kconfig
#
# Touchscreen driver configuration
#
#Its extension of Ur Kconfig -Add at last of Kconfig File

config TOUCHSCREEN_DOUBLETAP2WAKE
	tristate "DoubleTap2Wake for touchscreens"
	select TOUCHSCREEN_PREVENT_SLEEP
	default n
config TOUCHSCREEN_PREVENT_SLEEP
	bool "Inihibit sleep on modified touchscreen drivers"
	default n
	help
	  This disables the sleep function of modified touchscreen drivers.
	  	  
endif
```
